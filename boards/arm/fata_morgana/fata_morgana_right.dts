// This file was generated from a template. Edit it to match your keyboard.
// See https://zmk.dev/docs/development/hardware-integration/new-shield for more
// instructions.

#include "fata_morgana.dtsi"
#include "fata_morgana_left-pinctrl.dtsi"
#include <dt-bindings/input/input-event-codes.h>

/* 
Right side layout:
Skree tail
    Format:   
        Wire Color | Skree Node | MCU Node | Pin Code  
    Rows
        Orange   R6  -  not connected
        White    R5  -  not connected
        Blue     R4  -  not connected
        Green    R3 -> A3 (P0.28 - LS)
        Yellow   R2 -> A2 (P0.30 - LS)
        Black    R1 -> A1 (P0.05 - HS)
        Red      TR -> A0 (P0.04 - HS)
    Columns
        Red      C7 -  -  not connected
        Blck     C6 -  -  not connected
        Yellow   C5 -> 6  (P0.07 - HS)
        Green    C4 -> 9  (P0.26 - HS)
        Blue     C3 -> 10 (P0.27 - HS)
        White    C2 -> 11 (P0.06 - HS)
        Orange   C1 -> 12 (P0.08 - HS)
    Other
        ??????  LED -> 13 (P1.09 - HS)
PMW3610
    Format:   
        Wire Color | Skree Node | MCU Node | Pin Code  
    Purple    VIN -> 3.3V
    Brown     GND -> GND
    Blue     SDIO -> MI   (P0.15 - HS)
    Yellow   SCLK -> SCLK (P0.11 - HS)
    Orange    NCS -> 5    (P1.08 - HS)
    Red       Mot -> D2   (P0.10 - LS)
*/

&kscan {
    row-gpios
        = <&gpio0 5 (GPIO_ACTIVE_HIGH | GPIO_PULL_DOWN)>   // R1 - Black -> A1 (P0.05 - HS)
        , <&gpio0 30 (GPIO_ACTIVE_HIGH | GPIO_PULL_DOWN)>  // R2 - Yellow -> A2 (P0.30 - LS)
        , <&gpio0 28 (GPIO_ACTIVE_HIGH | GPIO_PULL_DOWN)>  // R3 - Green -> A3 (P0.28 - LS)
        , <&gpio0 4 (GPIO_ACTIVE_HIGH | GPIO_PULL_DOWN)>   // TR - Red -> A0 (P0.04 - HS)
        ;
    // Column GPIO pins for the right side matrix
    col-gpios
        = <&gpio0 7 (GPIO_ACTIVE_HIGH | GPIO_PULL_DOWN)>   // C5 - Yellow -> 6 (P0.07 - HS)
        , <&gpio0 26 (GPIO_ACTIVE_HIGH | GPIO_PULL_DOWN)>  // C4 - Green -> 9 (P0.26 - HS)
        , <&gpio0 27 (GPIO_ACTIVE_HIGH | GPIO_PULL_DOWN)>  // C3 - Blue -> 10 (P0.27 - HS)
        , <&gpio0 6 (GPIO_ACTIVE_HIGH | GPIO_PULL_DOWN)>   // C2 - White -> 11 (P0.06 - HS)
        , <&gpio0 8 (GPIO_ACTIVE_HIGH | GPIO_PULL_DOWN)>   // C1 - Orange -> 12 (P0.08 - HS)
        ;
};
