## boards/_shields/fata_morgana/Kconfig.defconfig
```kconfig
# Fata Morgana shield default configuration

if SHIELD_FATA_MORGANA_LEFT

config ZMK_KEYBOARD_NAME
    default "Fata Morgana"

config ZMK_SPLIT_ROLE_CENTRAL
    default y

endif

if SHIELD_FATA_MORGANA_LEFT || SHIELD_FATA_MORGANA_RIGHT

config ZMK_SPLIT
    default y

config ZMK_POINTING
    default y

config SPI
    default y

endif
```

## boards/arm/fata_morgana/Kconfig.board
```kconfig
config BOARD_FATA_MORGANA_LEFT
    bool "fata-morgana left"
    depends on SOC_NRF52840_QIAA

config BOARD_FATA_MORGANA_RIGHT
    bool "fata-morgana right"
    depends on SOC_NRF52840_QIAA
```

## boards/shields/fata_morgana/Kconfig.defconfig
```kconfig
if SHIELD_FATA_MORGANA_LEFT

config ZMK_KEYBOARD_NAME
    default "fata-morgana"

config ZMK_SPLIT_ROLE_CENTRAL
    default y

endif # SHIELD_FATA_MORGANA_LEFT

if SHIELD_FATA_MORGANA_LEFT || SHIELD_FATA_MORGANA_RIGHT

config ZMK_SPLIT
    default y

endif # SHIELD_FATA_MORGANA_LEFT || SHIELD_FATA_MORGANA_RIGHT
```

## boards/shields/fata_morgana/Kconfig.shield
```kconfig
# Fata Morgana shield configuration

config SHIELD_FATA_MORGANA_LEFT
    def_bool $(shields_list_contains,fata_morgana_left)

config SHIELD_FATA_MORGANA_RIGHT
    def_bool $(shields_list_contains,fata_morgana_right)
```
